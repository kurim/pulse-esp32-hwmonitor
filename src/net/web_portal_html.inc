static const char INDEX_HTML[] =
"<!DOCTYPE html><html lang=\"de\"><head><meta charset=\"UTF-8\"><meta name=\"viewport\" content=\"width=device-width, initial-scale=1\"><title>Pulse ESP32 Hardware-Monit"
"or</title><style>:root{--bg:#10141c;--card:#1a2030;--accent:#3fd0e0;--text:#e8edf4;--sub:#8893a8;--border:#2a3142;}*{box-sizing:border-box;}body{background:var("
"--bg);color:var(--text);font-family:-apple-system,Segoe UI,Roboto,Arial,sans-serif;margin:0;padding:24px 16px;}.wrap{max-width:560px;margin:0 auto;}h1{font-size"
":1.4rem;margin-bottom:4px;}.sub{color:var(--sub);margin-bottom:24px;font-size:.9rem;}.card{background:var(--card);border:1px solid var(--border);border-radius:1"
"0px;padding:18px 20px;margin-bottom:16px;}.card h2{font-size:1rem;margin:0 0 14px;color:var(--accent);}label{display:block;font-size:.82rem;color:var(--sub);mar"
"gin:10px 0 4px;}input[type=text],input[type=password],input[type=number],select{width:100%;padding:9px 10px;border-radius:6px;border:1px solid var(--border);bac"
"kground:#0d111a;color:var(--text);font-size:.95rem;}.row{display:flex;gap:12px;}.row>div{flex:1;}.toggle{display:flex;align-items:center;gap:10px;margin:10px 0;"
"}button{background:var(--accent);color:#04222a;border:none;border-radius:8px;padding:12px 18px;font-size:1rem;font-weight:600;cursor:pointer;width:100%;margin-t"
"op:6px;}button:hover{opacity:.9;}#status{margin-top:14px;font-size:.85rem;color:var(--sub);}.statbar{display:flex;gap:16px;font-size:.85rem;color:var(--sub);mar"
"gin-bottom:18px;flex-wrap:wrap;}.dot{display:inline-block;width:8px;height:8px;border-radius:50%;margin-right:6px;}.pintable{width:100%;border-collapse:collapse"
";margin-top:10px;font-size:.85rem;}.pintable td{padding:3px 6px;border-bottom:1px solid var(--border);}.pintable td:first-child{color:var(--sub);}.hint{font-siz"
"e:.8rem;color:var(--sub);margin-top:8px;}</style></head><body><div class=\"wrap\"><h1>Pulse ESP32 Hardware-Monitor</h1><div class=\"sub\"><span data-i18n=\"sub_title"
"\">Konfiguration (ESP-IDF)</span> <select id=\"langSwitch\" style=\"width:auto;display:inline-block;padding:2px 6px;font-size:.8rem;margin-left:6px\"><option value=\""
"de\">Deutsch</option><option value=\"en\">English</option></select></div><div class=\"statbar\" id=\"livebar\" data-i18n=\"loading_status\">Lade Status...</div><form id="
"\"cfgForm\"><div class=\"card\"><h2 data-i18n=\"card_mqtt\">Hardwaredaten-Quelle (MQTT / USB)</h2><label data-i18n=\"lbl_hw_source\">Quelle</label><select id=\"hw_source"
"\"><option value=\"0\" data-i18n=\"opt_hw_source_mqtt\">MQTT</option><option value=\"1\" data-i18n=\"opt_hw_source_usb\">USB/Seriell</option></select><div id=\"mqttFields"
"\"><label>Broker-Host</label><input type=\"text\" id=\"mqtt_host\" maxlength=\"64\"><div class=\"row\"><div><label>Port</label><input type=\"number\" id=\"mqtt_port\" min=\"1"
"\" max=\"65535\"></div><div><label>Topic</label><input type=\"text\" id=\"mqtt_topic\" maxlength=\"64\"></div></div><div class=\"row\"><div><label data-i18n=\"lbl_username\""
">Benutzer</label><input type=\"text\" id=\"mqtt_user\" maxlength=\"32\"></div><div><label data-i18n=\"lbl_password\">Passwort</label><input type=\"password\" id=\"mqtt_pas"
"s\" maxlength=\"64\" data-i18n-ph=\"ph_keep_empty\" placeholder=\"unver&auml;ndert lassen = leer\"></div></div></div><div id=\"usbHint\" class=\"hint\" style=\"display:none"
"\" data-i18n=\"hint_usb_source\">Sendet JSON-Zeilen (gleiches Format wie MQTT) per USB/Seriell an 115200 Baud, z.B. mit tools/pc_bridge_example.py --serial COM3.</"
"div></div><div class=\"card\"><h2 data-i18n=\"card_time\">Zeit</h2><label>NTP-Server</label><input type=\"text\" id=\"ntp_server\" maxlength=\"64\"><label data-i18n=\"lbl_"
"tz_preset\">Zeitzone</label><select id=\"tz_preset\" onchange=\"applyTzPreset()\"><option value=\"\">-</option><option value=\"UTC0\">UTC</option><option value=\"GMT0BST,"
"M3.5.0/1,M10.5.0\">London</option><option value=\"CET-1CEST,M3.5.0,M10.5.0/3\">Berlin/Paris/Rom/Madrid</option><option value=\"EET-2EEST,M3.5.0/3,M10.5.0/4\">Helsink"
"i/Athen/Bukarest</option><option value=\"MSK-3\">Moskau</option><option value=\"<+03>-3\">Istanbul</option><option value=\"EST5EDT,M3.2.0,M11.1.0\">New York (Eastern)"
"</option><option value=\"CST6CDT,M3.2.0,M11.1.0\">Chicago (Central)</option><option value=\"MST7MDT,M3.2.0,M11.1.0\">Denver (Mountain)</option><option value=\"PST8PD"
"T,M3.2.0,M11.1.0\">Los Angeles (Pacific)</option><option value=\"<-03>3\">Sao Paulo</option><option value=\"CST6\">Mexiko-Stadt</option><option value=\"<+04>-4\">Dubai"
"</option><option value=\"IST-5:30\">Neu-Delhi/Kolkata</option><option value=\"CST-8\">Shanghai/Peking</option><option value=\"JST-9\">Tokio</option><option value=\"<+0"
"8>-8\">Singapur</option><option value=\"KST-9\">Seoul</option><option value=\"AEST-10AEDT,M10.1.0,M4.1.0/3\">Sydney</option><option value=\"NZST-12NZDT,M9.5.0,M4.1.0/"
"3\">Auckland</option><option value=\"EET-2EEST,M4.5.5/0,M10.5.4/24\">Kairo</option><option value=\"SAST-2\">Johannesburg</option><option value=\"custom\" data-i18n=\"op"
"t_tz_custom\">Benutzerdefiniert</option></select><label data-i18n=\"lbl_posix_tz\">POSIX-Zeitzone</label><input type=\"text\" id=\"tz\" maxlength=\"64\"><div class=\"hint"
"\" data-i18n=\"hint_tz\">Meist nicht n&ouml;tig - oben per Dropdown w&auml;hlen.</div></div><div class=\"card\"><h2 data-i18n=\"card_weather\">Wetter (optional, OpenWe"
"atherMap)</h2><div class=\"toggle\"><input type=\"checkbox\" id=\"weather_enabled\"><label style=\"margin:0\" data-i18n=\"lbl_enable\">Aktivieren</label></div><label>API-"
"Key</label><input type=\"text\" id=\"weather_api_key\" maxlength=\"40\" data-i18n-ph=\"ph_keep_empty\" placeholder=\"unver&auml;ndert lassen = leer\"><div class=\"row\"><di"
"v><label data-i18n=\"lbl_location\">Ort (Stadt,Land)</label><input type=\"text\" id=\"weather_city\" maxlength=\"64\"></div><div><label data-i18n=\"lbl_unit\">Einheit</la"
"bel><select id=\"weather_units\"><option value=\"metric\">&deg;C</option><option value=\"imperial\">&deg;F</option></select></div></div></div><div class=\"card\"><h2 da"
"ta-i18n=\"card_display\">Display</h2><div id=\"displayFixed\" class=\"sub\" style=\"display:none;margin-bottom:6px\"></div><div id=\"displayChoice\"><label data-i18n=\"lbl"
"_display_type\">Displaytyp</label><select id=\"display_type\"></select></div><div id=\"displayInfo\"></div><div class=\"hint\" data-i18n=\"hint_display_reboot\">Nach dem"
" Speichern startet das Ger&auml;t neu und initialisiert das gew&auml;hlte Panel. Verdrahtung wie oben angezeigt oder weiter unten die PINs anpassen.</div><div c"
"lass=\"row\" style=\"margin-top:10px\"><div><label data-i18n=\"lbl_brightness\">Helligkeit (0-255)</label><input type=\"number\" id=\"brightness\" min=\"0\" max=\"255\"></div"
"><div><label data-i18n=\"lbl_rotation\">Rotation/Spiegelung</label><select id=\"rotation\"></select></div></div><div class=\"row\"><div><label data-i18n=\"lbl_language"
"\">Sprache (Ger&auml;t-Display)</label><select id=\"language\"><option value=\"de\">Deutsch</option><option value=\"en\">English</option></select></div><div></div></di"
"v><label data-i18n=\"lbl_standby\">Standby nach (Sekunden ohne Hardwaredaten, 0 = deaktiviert)</label><input type=\"number\" id=\"standby_timeout_s\" min=\"0\" max=\"655"
"35\"></div><div class=\"card\" id=\"pinCard\"><h2 data-i18n=\"card_pins\">Pin-Belegung (optional anpassen)</h2><div class=\"hint\" data-i18n=\"hint_pins\">Leer lassen = St"
"andard-Pin f&uuml;r den oben gew&auml;hlten Displaytyp verwenden (siehe Tabelle oben). Nur bei abweichender eigener Verdrahtung &auml;ndern. Wechselt der Displa"
"ytyp, werden alle Pin-Overrides zur&uuml;ckgesetzt.</div><div id=\"pinGroupSpi\" style=\"margin-top:10px\"><div class=\"row\"><div><label>MOSI</label><input type=\"num"
"ber\" id=\"pin_mosi\" min=\"0\" max=\"48\"></div><div><label data-i18n=\"lbl_miso\">MISO (-1 = kein Pin)</label><input type=\"number\" id=\"pin_miso\" min=\"-1\" max=\"48\"></di"
"v></div><div class=\"row\"><div><label>SCLK</label><input type=\"number\" id=\"pin_sclk\" min=\"0\" max=\"48\"></div><div><label>CS</label><input type=\"number\" id=\"pin_cs"
"\" min=\"0\" max=\"48\"></div></div><div class=\"row\"><div><label>DC</label><input type=\"number\" id=\"pin_dc\" min=\"0\" max=\"48\"></div><div><label data-i18n=\"lbl_reset_p"
"in\">RESET (-1 = kein Pin)</label><input type=\"number\" id=\"pin_rst\" min=\"-1\" max=\"48\"></div></div><div class=\"row\"><div><label data-i18n=\"lbl_backlight_pin\">Back"
"light (-1 = kein Pin)</label><input type=\"number\" id=\"pin_bl\" min=\"-1\" max=\"48\"></div><div></div></div></div><div id=\"pinGroupTouch\"><div class=\"row\"><div><labe"
"l>Touch CS</label><input type=\"number\" id=\"pin_touch_cs\" min=\"0\" max=\"48\"></div><div><label>Touch IRQ</label><input type=\"number\" id=\"pin_touch_irq\" min=\"0\" max"
"=\"48\"></div></div><div class=\"row\"><div><label>Touch MOSI</label><input type=\"number\" id=\"pin_touch_mosi\" min=\"0\" max=\"48\"></div><div><label>Touch MISO</label><"
"input type=\"number\" id=\"pin_touch_miso\" min=\"0\" max=\"48\"></div></div><div class=\"row\"><div><label>Touch CLK</label><input type=\"number\" id=\"pin_touch_clk\" min=\""
"0\" max=\"48\"></div><div></div></div></div><div id=\"pinGroupI2c\"><div class=\"row\"><div><label>SDA</label><input type=\"number\" id=\"pin_i2c_sda\" min=\"0\" max=\"48\"></"
"div><div><label>SCL</label><input type=\"number\" id=\"pin_i2c_scl\" min=\"0\" max=\"48\"></div></div><label data-i18n=\"lbl_i2c_addr\">I2C-Adresse (dezimal, z.B. 60 f&uu"
"ml;r 0x3C)</label><input type=\"number\" id=\"pin_i2c_addr\" min=\"1\" max=\"127\"></div><div id=\"pinGroupTouchI2c\"><div class=\"row\"><div><label>Touch RESET</label><inp"
"ut type=\"number\" id=\"pin_touch_rst\" min=\"0\" max=\"48\"></div><div><label>Touch INT</label><input type=\"number\" id=\"pin_touch_int\" min=\"0\" max=\"48\"></div></div></d"
"iv><div id=\"pinGroupNav\"><label data-i18n=\"lbl_nav_button\">Navigationstaste (BOOT-Button, -1 = keine)</label><input type=\"number\" id=\"pin_nav_button\" min=\"-1\" m"
"ax=\"48\"></div></div><button type=\"submit\" data-i18n=\"btn_save_cfg\">Speichern &amp; Neustart</button><div id=\"status\"></div></form><div class=\"card\"><h2 data-i18"
"n=\"card_ota\">Firmware-Update (OTA)</h2><div class=\"sub\" style=\"margin-bottom:10px\"><span data-i18n=\"lbl_current_version\">Aktuelle Version:</span> <span id=\"fwVe"
"rsion\">-</span></div><input type=\"file\" id=\"fwFile\" accept=\".bin\"><button type=\"button\" onclick=\"uploadFirmware()\" data-i18n=\"btn_upload_fw\" style=\"background:#"
"e0a53f\">.bin hochladen &amp; flashen</button><progress id=\"otaProgress\" value=\"0\" max=\"100\" style=\"width:100%;margin-top:10px;display:none\"></progress><div id=\""
"otaStatus\" style=\"margin-top:8px;font-size:.85rem;color:var(--sub)\"></div></div></div><script>const I18N={de:{sub_title:'Konfiguration (ESP-IDF)',loading_status"
":'Lade Status...',card_wifi:'WLAN',lbl_password:'Passwort',ph_keep_empty:'unver\\u00e4ndert lassen = leer',card_mqtt:'Hardwaredaten-Quelle (MQTT / USB)',lbl_hw_s"
"ource:'Quelle',opt_hw_source_mqtt:'MQTT',opt_hw_source_usb:'USB/Seriell',hint_usb_source:'Sendet JSON-Zeilen (gleiches Format wie MQTT) per USB/Seriell an 11520"
"0 Baud, z.B. mit tools/pc_bridge_example.py --serial COM3.',lbl_username:'Benutzer',card_time:'Zeit',lbl_tz_preset:'Zeitzone',opt_tz_custom:'Benutzerdefiniert',"
"hint_tz:'Meist nicht n\\u00f6tig - oben per Dropdown w\\u00e4hlen.',lbl_posix_tz:'POSIX-Zeitzone',card_weather:'Wetter (optional, OpenWeatherMap)',lbl_enable:'Akt"
"ivieren',lbl_location:'Ort (Stadt,Land)',lbl_unit:'Einheit',card_display:'Display',lbl_display_type:'Displaytyp',hint_display_reboot:'Nach dem Speichern startet"
" das Ger\\u00e4t neu und initialisiert das gew\\u00e4hlte Panel. Verdrahtung wie oben angezeigt oder weiter unten die PINs anpassen.',lbl_brightness:'Helligkeit ("
"0-255)',lbl_rotation:'Rotation/Spiegelung',lbl_language:'Sprache (Ger\\u00e4t-Display)',lbl_standby:'Standby nach (Sekunden ohne Hardwaredaten, 0 = deaktiviert)'"
",card_pins:'Pin-Belegung (optional anpassen)',hint_pins:'Leer lassen = Standard-Pin f\\u00fcr den oben gew\\u00e4hlten Displaytyp verwenden (siehe Tabelle oben). "
"Nur bei abweichender eigener Verdrahtung \\u00e4ndern. Wechselt der Displaytyp, werden alle Pin-Overrides zur\\u00fcckgesetzt.',lbl_miso:'MISO (-1 = kein Pin)',lb"
"l_reset_pin:'RESET (-1 = kein Pin)',lbl_backlight_pin:'Backlight (-1 = kein Pin)',lbl_i2c_addr:'I2C-Adresse (dezimal, z.B. 60 f\\u00fcr 0x3C)',lbl_nav_button:'Na"
"vigationstaste (BOOT-Button, -1 = keine)',btn_save_cfg:'Speichern & Neustart',card_ota:'Firmware-Update (OTA)',lbl_current_version:'Aktuelle Version:',btn_uploa"
"d_fw:'.bin hochladen & flashen',saving:'Speichere...',saved_restarting:'Gespeichert. Ger\\u00e4t startet neu...',select_bin_first:'Bitte zuerst eine .bin-Datei a"
"usw\\u00e4hlen.',confirm_flash_prefix:'Firmware \"',confirm_flash_suffix:'\" jetzt aufspielen? Das Ger\\u00e4t startet danach automatisch neu.',uploading:'Lade hoch"
"...',update_success:'Update erfolgreich - Ger\\u00e4t startet neu.',update_fail_prefix:'Fehler beim Update: ',upload_conn_error:'Verbindungsfehler beim Hochladen"
".',resolution:'Aufl\\u00f6sung',shape_round:' (rund)',shape_mono:' (monochrom)',not_wired:'nicht verdrahtet',no_pin_self_lit:'kein Pin (selbstleuchtend)',i2c_add"
"ress:'I2C-Adresse',rotated_180:'180\\u00b0 gedreht',touch_also_rotated:' (Touch ebenfalls gedreht)',fixed_wiring:'Fest verbaut',no_display_profile:'Kein Display-"
"Profil f\\u00fcr dieses Firmware-Target verf\\u00fcgbar.',free_memory_suffix:' (freier Speicher: '},en:{sub_title:'Configuration (ESP-IDF)',loading_status:'Loadin"
"g status...',card_wifi:'WiFi',lbl_password:'Password',ph_keep_empty:'leave empty = unchanged',card_mqtt:'Hardware data source (MQTT / USB)',lbl_hw_source:'Sourc"
"e',opt_hw_source_mqtt:'MQTT',opt_hw_source_usb:'USB/Serial',hint_usb_source:'Sends JSON lines (same format as MQTT) over USB/serial at 115200 baud, e.g. with to"
"ols/pc_bridge_example.py --serial COM3.',lbl_username:'Username',card_time:'Time',lbl_tz_preset:'Timezone',opt_tz_custom:'Custom',hint_tz:'Usually not needed - "
"pick from the dropdown above.',lbl_posix_tz:'POSIX timezone',card_weather:'Weather (optional, OpenWeatherMap)',lbl_enable:'Enable',lbl_location:'Location (city,"
"country)',lbl_unit:'Unit',card_display:'Display',lbl_display_type:'Display type',hint_display_reboot:'After saving, the device restarts and initializes the sele"
"cted panel. Wire it as shown above, or adjust the PINs below.',lbl_brightness:'Brightness (0-255)',lbl_rotation:'Rotation/mirroring',lbl_language:'Language (dev"
"ice display)',lbl_standby:'Standby after (seconds without hardware data, 0 = disabled)',card_pins:'Pin assignment (optional)',hint_pins:'Leave empty = use the d"
"efault pin for the display type selected above (see table above). Only change for different custom wiring. Changing the display type resets all pin overrides.',"
"lbl_miso:'MISO (-1 = no pin)',lbl_reset_pin:'RESET (-1 = no pin)',lbl_backlight_pin:'Backlight (-1 = no pin)',lbl_i2c_addr:'I2C address (decimal, e.g. 60 for 0x"
"3C)',lbl_nav_button:'Navigation button (BOOT button, -1 = none)',btn_save_cfg:'Save & restart',card_ota:'Firmware update (OTA)',lbl_current_version:'Current ver"
"sion:',btn_upload_fw:'Upload & flash .bin',saving:'Saving...',saved_restarting:'Saved. Device is restarting...',select_bin_first:'Please select a .bin file firs"
"t.',confirm_flash_prefix:'Flash firmware \"',confirm_flash_suffix:'\" now? The device will restart automatically afterwards.',uploading:'Uploading...',update_succ"
"ess:'Update successful - device is restarting.',update_fail_prefix:'Update failed: ',upload_conn_error:'Connection error during upload.',resolution:'Resolution'"
",shape_round:' (round)',shape_mono:' (monochrome)',not_wired:'not wired',no_pin_self_lit:'no pin (self-lit)',i2c_address:'I2C address',rotated_180:'180\\u00b0 ro"
"tated',touch_also_rotated:' (touch also rotated)',fixed_wiring:'Fixed',no_display_profile:'No display profile available for this firmware target.',free_memory_s"
"uffix:' (free memory: '}};let currentLang='de';function t(key){return (I18N[currentLang]&&I18N[currentLang][key])||key;}function applyI18n(lang){if(!I18N[lang])"
"lang='de';currentLang=lang;document.documentElement.lang=lang;document.querySelectorAll('[data-i18n]').forEach(function(el){el.textContent=t(el.dataset.i18n);})"
";document.querySelectorAll('[data-i18n-ph]').forEach(function(el){el.placeholder=t(el.dataset.i18nPh);});const langSwitch=document.getElementById('langSwitch');"
"if(langSwitch)langSwitch.value=lang;if(displays.length){renderDisplayInfo();renderRotationOptions();}}let displays=[];function renderDisplayInfo(){const key=doc"
"ument.getElementById('display_type').value;const d=displays.find(x=>x.key===key);const el=document.getElementById('displayInfo');if(!d||d.bus==='none'){el.inner"
"HTML='';return;}let rows='<tr><td>Bus</td><td>'+d.bus.toUpperCase()+(d.has_touch?(d.bus==='rgb'?' + Touch (GT911)':' + Touch (XPT2046)'):'')+'</td></tr>'+'<tr><"
"td>'+t('resolution')+'</td><td>'+d.h_res+'x'+d.v_res+(d.shape==='round'?t('shape_round'):d.shape==='mono'?t('shape_mono'):'')+'</td></tr>';if(d.bus==='spi'){row"
"s+='<tr><td>MOSI/MISO/SCLK</td><td>GPIO'+d.pins.mosi+' / GPIO'+d.pins.miso+' / GPIO'+d.pins.sclk+'</td></tr>'+'<tr><td>CS / DC</td><td>GPIO'+d.pins.cs+' / GPIO'"
"+d.pins.dc+'</td></tr>'+'<tr><td>RESET</td><td>'+(d.pins.rst<0?t('not_wired'):'GPIO'+d.pins.rst)+'</td></tr>'+'<tr><td>Backlight</td><td>'+(d.pins.bl<0?t('no_pi"
"n_self_lit'):'GPIO'+d.pins.bl)+'</td></tr>';if(d.has_touch){rows+='<tr><td>Touch CS/IRQ</td><td>GPIO'+d.pins.touch_cs+' / GPIO'+d.pins.touch_irq+'</td></tr>'+'<"
"tr><td>Touch MOSI/MISO/CLK</td><td>GPIO'+d.pins.touch_mosi+' / GPIO'+d.pins.touch_miso+' / GPIO'+d.pins.touch_clk+'</td></tr>';}}else if(d.bus==='rgb'){rows+='<"
"tr><td>'+t('fixed_wiring')+'</td><td>RGB565, 16-bit (800x480)</td></tr>'+'<tr><td>Touch SDA/SCL</td><td>GPIO'+d.pins.sda+' / GPIO'+d.pins.scl+'</td></tr>'+'<tr>"
"<td>Touch '+t('i2c_address')+'</td><td>0x'+d.pins.addr.toString(16).toUpperCase()+'</td></tr>'+'<tr><td>Touch RESET/INT</td><td>GPIO'+d.pins.touch_rst+' / GPIO'"
"+d.pins.touch_int+'</td></tr>';}else{rows+='<tr><td>SDA / SCL</td><td>GPIO'+d.pins.sda+' / GPIO'+d.pins.scl+'</td></tr>'+'<tr><td>'+t('i2c_address')+'</td><td>0"
"x'+d.pins.addr.toString(16).toUpperCase()+'</td></tr>'+'<tr><td>VCC / GND</td><td>3.3V / GND</td></tr>';}el.innerHTML='<table class=\"pintable\">'+rows+'</table>'"
";}let activeKey='';const PIN_FIELDS=['mosi','miso','sclk','cs','dc','rst','bl','touch_cs','touch_irq','touch_mosi','touch_miso','touch_clk','i2c_sda','i2c_scl',"
"'i2c_addr','nav_button','touch_rst','touch_int'];const PIN_KEY_MAP={i2c_sda:'sda',i2c_scl:'scl',i2c_addr:'addr'};const FIXED_WIRING_KEY='cyd_ili9341';function u"
"pdatePinFields(){const key=document.getElementById('display_type').value;const d=displays.find(x=>x.key===key);if(!d)return;const fixed=(key===FIXED_WIRING_KEY)"
"||(d.bus==='none');document.getElementById('pinCard').style.display=fixed?'none':'';document.getElementById('pinGroupSpi').style.display=d.bus==='spi'?'':'none'"
";document.getElementById('pinGroupTouch').style.display=(d.has_touch&&d.bus==='spi')?'':'none';document.getElementById('pinGroupI2c').style.display=(d.bus==='i2"
"c'||d.bus==='rgb')?'':'none';document.getElementById('pinGroupTouchI2c').style.display=(d.bus==='rgb'&&d.has_touch)?'':'none';document.getElementById('pinGroupN"
"av').style.display=d.shape==='round'?'':'none';PIN_FIELDS.forEach(f=>{const el=document.getElementById('pin_'+f);if(!el)return;const srcKey=PIN_KEY_MAP[f]||f;el"
".placeholder=(d.pins[srcKey]!==undefined)?('Default: '+d.pins[srcKey]):'Default';if(key!==activeKey)el.value='';});}function renderRotationOptions(){const key=d"
"ocument.getElementById('display_type').value;const d=displays.find(x=>x.key===key);const sel=document.getElementById('rotation');const prev=sel.value;const opts"
"=(d&&(d.shape==='rect'))?[[1,'Standard'],[3,t('rotated_180')+(d.has_touch?t('touch_also_rotated'):'')]]:(key==='guition_jc8048w550')?[[0,'Rotation 0'],[3,t('rot"
"ated_180')+(d.has_touch?t('touch_also_rotated'):'')]]:[[0,'Rotation 0'],[1,'Rotation 1'],[2,'Rotation 2'],[3,'Rotation 3']];sel.innerHTML='';opts.forEach(o=>{co"
"nst el=document.createElement('option');el.value=o[0];el.textContent=o[1];sel.appendChild(el);});if(opts.some(o=>String(o[0])===prev))sel.value=prev;}async func"
"tion loadDisplays(){const r=await fetch('/api/displays');displays=await r.json();const sel=document.getElementById('display_type');sel.innerHTML='';displays.for"
"Each(d=>{const o=document.createElement('option');o.value=d.key;o.textContent=d.name;sel.appendChild(o);});sel.addEventListener('change',()=>{renderDisplayInfo("
");renderRotationOptions();updatePinFields();});if(displays.length<=1){document.getElementById('displayChoice').style.display='none';const f=document.getElementB"
"yId('displayFixed');f.style.display='block';f.textContent=displays.length?(t('fixed_wiring')+': '+displays[0].name):t('no_display_profile');if(displays.length)s"
"el.value=displays[0].key;}}async function loadCfg(){const r=await fetch('/api/config');const c=await r.json();if(c.display_type!==undefined)document.getElementB"
"yId('display_type').value=c.display_type;activeKey=document.getElementById('display_type').value;renderRotationOptions();for(const k in c){const el=document.get"
"ElementById(k);if(!el)continue;if(el.type==='checkbox')el.checked=!!c[k];else el.value=(c[k]===null?'':c[k]);}renderDisplayInfo();updatePinFields();updateHwSour"
"ceVisibility();syncTzPreset();}function applyTzPreset(){const v=document.getElementById('tz_preset').value;if(v&&v!=='custom')document.getElementById('tz').valu"
"e=v;}function syncTzPreset(){const v=document.getElementById('tz').value;const sel=document.getElementById('tz_preset');let found=false;for(const o of sel.optio"
"ns){if(o.value===v){sel.value=v;found=true;break;}}if(!found)sel.value='custom';}function updateHwSourceVisibility(){const v=document.getElementById('hw_source'"
").value;document.getElementById('mqttFields').style.display=(v==='1')?'none':'';document.getElementById('usbHint').style.display=(v==='1')?'':'none';}document.g"
"etElementById('hw_source').addEventListener('change',updateHwSourceVisibility);async function loadStatus(){try{const r=await fetch('/api/status');const s=await "
"r.json();document.getElementById('fwVersion').innerText=s.fw_version+t('free_memory_suffix')+Math.round(s.free_heap/1024)+' KB)';const hwOk=(s.hw_source===1)?s."
"serial:s.mqtt;const hwLabel=(s.hw_source===1)?'USB':'MQTT';document.getElementById('livebar').innerHTML='<span><span class=\"dot\" style=\"background:'+(s.wifi?'#3"
"fd0e0':'#e05a5a')+'\"></span>'+t('card_wifi')+'</span>'+'<span><span class=\"dot\" style=\"background:'+(hwOk?'#3fd0e0':'#e05a5a')+'\"></span>'+hwLabel+'</span>'+'<s"
"pan>CPU '+s.cpu_load.toFixed(0)+'%</span><span>GPU '+s.gpu_load.toFixed(0)+'%</span><span>IP '+s.ip+'</span>';}catch(e){}}document.getElementById('cfgForm').add"
"EventListener('submit',async(e)=>{e.preventDefault();const ids=['hw_source','mqtt_host','mqtt_port','mqtt_user','mqtt_pass','mqtt_topic','ntp_server','tz','weat"
"her_enabled','weather_api_key','weather_city','weather_units','brightness','rotation','language','display_type','standby_timeout_s'];PIN_FIELDS.forEach(f=>ids.p"
"ush('pin_'+f));const payload={};ids.forEach(id=>{const el=document.getElementById(id);if(!el)return;if(el.type==='checkbox')payload[id]=el.checked;else if(el.ty"
"pe==='number')payload[id]=(el.value===''?null:Number(el.value));else if(id==='rotation'||id==='hw_source')payload[id]=Number(el.value);else payload[id]=el.value"
";});document.getElementById('status').innerText=t('saving');await fetch('/api/config',{method:'POST',headers:{'Content-Type':'application/json'},body:JSON.strin"
"gify(payload)});document.getElementById('status').innerText=t('saved_restarting');});function uploadFirmware(){const f=document.getElementById('fwFile').files[0"
"];if(!f){alert(t('select_bin_first'));return;}if(!confirm(t('confirm_flash_prefix')+f.name+t('confirm_flash_suffix')))return;const p=document.getElementById('ot"
"aProgress'),s=document.getElementById('otaStatus');p.style.display='block';p.value=0;s.innerText=t('uploading');const xhr=new XMLHttpRequest();xhr.open('POST','"
"/update',true);xhr.setRequestHeader('Content-Type','application/octet-stream');xhr.upload.onprogress=function(e){if(e.lengthComputable){const pct=Math.round(e.l"
"oaded/e.total*100);p.value=pct;s.innerText=t('uploading')+' '+pct+'%';}};xhr.onload=function(){s.innerText=xhr.status===200?t('update_success'):t('update_fail_p"
"refix')+xhr.responseText;};xhr.onerror=function(){s.innerText=t('upload_conn_error');};xhr.send(f);}let initialLang=localStorage.getItem('lang')||(navigator.lan"
"guage||'de').slice(0,2);if(!I18N[initialLang])initialLang='de';applyI18n(initialLang);document.getElementById('langSwitch').addEventListener('change',(e)=>{loca"
"lStorage.setItem('lang',e.target.value);applyI18n(e.target.value);});loadDisplays().then(loadCfg);loadStatus();setInterval(loadStatus,2000);</script></body></ht"
"ml>";
